## config/boards/shields/le_jlwffre/Kconfig.defconfig
```kconfig
# Copyright (c) 2024 The ZMK Contributors
# SPDX-License-Identifier: MIT

if SHIELD_LE_JLWFFRE

config ZMK_KEYBOARD_NAME
    default "Le JLWffre"

# USB and Console configurations are now handled in le_jlwffre.conf

endif
```

## config/boards/shields/le_jlwffre/Kconfig.shield
```kconfig
# Copyright (c) 2024 The ZMK Contributors
# SPDX-License-Identifier: MIT

config SHIELD_LE_JLWFFRE
    def_bool $(shields_list_contains,le_jlwffre)
```

## config/west.yml
```yaml
manifest:
  remotes:
    - name: zmkfirmware
      url-base: https://github.com/zmkfirmware
    - name: jlw
      url-base: https://github.com/josh-l-wang
  projects:
    - name: zmk
      remote: zmkfirmware
      revision: main
      import: app/west.yml
    - name: zmk-jlw-keyboards
      remote: jlw
      revision: main
      path: boards/arm/le_jlwffre
  self:
    path: config
```
